/*
 * Copyright 2017 NXP
 *
 * This program is free software; you can redistribute it and/or
 * modify it under the terms of the GNU General Public License
 * as published by the Free Software Foundation; either version 2
 * of the License, or (at your option) any later version.
 *
 * This program is distributed in the hope that it will be useful,
 * but WITHOUT ANY WARRANTY; without even the implied warranty of
 * MERCHANTABILITY or FITNESS FOR A PARTICULAR PURPOSE.  See the
 * GNU General Public License for more details.
 */

/dts-v1/;
/plugin/;

#include <dt-bindings/pinctrl/pins-imx8mm.h>

/ {
	compatible = "fsl,imx8mm-evk","fsl,seco-imx8mm-c61", "fsl,imx8mm"; 

/*  __________________________________________________________________________
 * |                                                                          |
 * |                               GPIOs PORT2	                              |
 * |__________________________________________________________________________|
 */


	fragment@0 {
                target = <&pinctrl_io_header_p2>;
                __overlay__ {
                        fsl,pins = <
				MX8MM_IOMUXC_ECSPI2_SCLK_GPIO5_IO10             0x19
				MX8MM_IOMUXC_ECSPI2_MOSI_GPIO5_IO11           0x19
				MX8MM_IOMUXC_ECSPI2_SS0_GPIO5_IO13              0x19
				MX8MM_IOMUXC_ECSPI2_MISO_GPIO5_IO12           0x19
                        >;

                };
        };

};

