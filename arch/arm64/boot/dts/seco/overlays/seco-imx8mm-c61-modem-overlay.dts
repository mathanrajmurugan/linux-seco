/*
 * Copyright 2017 NXP
 *
 * This program is free software; you can redistribute it and/or
 * modify it under the terms of the GNU General Public License
 * as published by the Free Software Foundation; either version 2
 * of the License, or (at your option) any later version.
 *
 * This program is distributed in the hope that it will be useful,
 * but WITHOUT ANY WARRANTY; without even the implied warranty of
 * MERCHANTABILITY or FITNESS FOR A PARTICULAR PURPOSE.  See the
 * GNU General Public License for more details.
 */

/dts-v1/;
/plugin/;

/ {
	compatible = "fsl,imx8mm-evk","fsl,seco-imx8mm-c61", "fsl,imx8mm"; 

/*  __________________________________________________________________________
 * |                                                                          |
 * |                               MODEM 	                              |
 * |__________________________________________________________________________|
 */


    	fragment@1 {
        	target = <&usb_uab_switch_on>;
        	__overlay__ {
				regulator-always-on;
				regulator-boot-on; 
		};
	};

};

