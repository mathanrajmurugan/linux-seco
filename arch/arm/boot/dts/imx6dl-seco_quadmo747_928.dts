

/dts-v1/;

#include "imx6dl.dtsi"
#include "imx6qdl-seco_quadmo747_928.dtsi"
#include "imx6qdl-seco_lvds_display.dtsi"

/ {
	model = "SECO i.MX6 DualLite/Solo Quadmo747 (928) Board";
	compatible = "fsl,imx6dl-quadmo747_928", "fsl,imx6dl";
};


&ldb {
	status = "disabled";

	lvds_ch0: lvds-channel@0 {
		status = "disabled";
		crtc   = "ipu1-di0";
	};

	lvds_ch1: lvds-channel@1 {
		status = "disabled";
		crtc   = "ipu1-di1";
	};	
};

