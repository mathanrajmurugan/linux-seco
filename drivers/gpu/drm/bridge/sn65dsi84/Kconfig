## drivers/gpu/drm/bridge/sn65dsi84/Kconfig
```kconfig
config DRM_I2C_SN65DSI84
	tristate "sn65dsi84 bridge"
	depends on OF
	select DRM_KMS_HELPER
	select REGMAP_I2C
	help
	  Support for the TI SN65DSI84 LVDS Bridge.
```

## drivers/net/wireless/marvell/sd8997/Kconfig
```kconfig
config SD8997
	tristate "Marvel 8997 wireless cards support"
	depends on MMC
	default n
	---help---
	  This module adds support for wireless adapters based on
	  Marvel 8997 chipset.

config SD8997_STA_SUPPORT
	depends on SD8997
	bool "WLAN station support"
	default y

config SD8997_UAP_SUPPORT
	depends on SD8997
	bool "Soft AP Support"
	default y

config SD8997_WIFI_DIRECT_SUPPORT
	depends on SD8997
	bool "WiFi Direct Support"
	default y

config SD8997_WIFI_DISPLAY_SUPPORT
	depends on SD8997
	bool "WiFi Display Support"
	default n

config SD8997_STA_WEXT
	depends on SD8997
	depends on !CFG80211
	bool "station wext support"
	default n

config SD8997_UAP_WEXT
	depends on SD8997
	depends on !CFG80211
	bool "UAP wext support"
	default n

config SD8997_DEBUG
	depends on SD8997
	bool "Debug option"
	default n
	---help---
          DEBUG LEVEL n/1/2:
          n: NO DEBUG
          1: Only PRINTM(MMSG,...), PRINTM(MFATAL,...), ...
          2: All PRINTM()
```

## drivers/seco/Kconfig
```kconfig
#
#  SECO system driver
#

menu "SECO mxc support"

config ECTRL
	bool "Communication system with the Embedded Controller"
	depends on I2C && ARCH_MXC
	help
		Say Y here if you want to use the Seco Communication System with the Embedded Controller.

		if usure, say Y.

config ECTRL_STM32
	bool "Communication system with the Embedded Controller STM32"
	depends on I2C && ARCH_MXC
	help
		Say Y here if you want to use the Seco Communication System with the Embedded Controller stm32.

		if usure, say Y.

config SECO_CPLD_FW
	bool "CLPD Firmware management system"
	depends on ARCH_MXC
	help
		Say Y here if you want to use the CLPD Firmware management system.

		if usure, say Y.


config SECO_PWR_BTN
	bool "SECO power button management system"
	depends on ARCH_MXC
	help
		Say Y here if you want to use the SECO power button management system.

		if usure, say Y.


config BUZZER
        bool "Buzzer Support"
	depends on PWM
        help
            This option enables support for Audio Buzzer.
            You can change pwm buzzer parameters through sysfs.

            If unsure, say Y.


config BOARD_SECO_ID
		bool "S-Series board identification support"
	depends on ARCH_MXC

endmenu
```
