/dts-v1/;
/plugin/;

/ {
	compatible = "fsl,imx6q-SBC_A62", "fsl,imx6dl-SBC_A62", "fsl,imx6q", "fsl,imx6dl";

    fragment@0 {
   		target = <&gt928>;
        __overlay__ {

            status = "okay";

		};
	};
	
};
