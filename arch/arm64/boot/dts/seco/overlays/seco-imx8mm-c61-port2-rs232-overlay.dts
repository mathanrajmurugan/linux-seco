/*
 * Copyright 2017 NXP
 *
 * This program is free software; you can redistribute it and/or
 * modify it under the terms of the GNU General Public License
 * as published by the Free Software Foundation; either version 2
 * of the License, or (at your option) any later version.
 *
 * This program is distributed in the hope that it will be useful,
 * but WITHOUT ANY WARRANTY; without even the implied warranty of
 * MERCHANTABILITY or FITNESS FOR A PARTICULAR PURPOSE.  See the
 * GNU General Public License for more details.
 */

/dts-v1/;
/plugin/;

/ {
	compatible = "fsl,imx8mm-evk","fsl,seco-imx8mm-c61", "fsl,imx8mm"; 

/*  __________________________________________________________________________
 * |                                                                          |
 * |                               RS232 PORT2	                              |
 * |__________________________________________________________________________|
 */


    	fragment@1 {
        	target = <&uart4>;
        	__overlay__ {
			status = "okay";
		};
	};
};

